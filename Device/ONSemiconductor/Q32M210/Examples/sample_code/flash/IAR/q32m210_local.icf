//-----------------------------------------------------------------------------
// Copyright (c) 2009 - 2012 Semiconductor Components Industries, LLC
// (d/b/a ON Semiconductor). All Rights Reserved.
//
// This code is the property of ON Semiconductor and may not be redistributed
// in any form without prior written permission from ON Semiconductor. The
// terms of use and warranty for this code are covered by contractual
// agreements between ON Semiconductor and the licensee.
//-----------------------------------------------------------------------------
// q32m210_local.icf
// - Linker config file for sample code applications
//-----------------------------------------------------------------------------
// $Revision: 1.3 $
// $Date: 2012/04/26 18:50:01 $
//-----------------------------------------------------------------------------

include "..\..\..\..\Source\Templates\IAR\q32m210.icf";

//-----------------------------------------------------------------------------
// Memory Definitions
//-----------------------------------------------------------------------------

// Define a region for the on-chip flash.
define region FLASH_DATA = mem:[from 0x00070000 to 0x007ffff];

//-----------------------------------------------------------------------------
// Application Layout
//-----------------------------------------------------------------------------

// Indicate the location of the flash data section and that it should not be
// initialized.
place at start of FLASH_DATA { section .flashdata };
do not initialize { section .flashdata };
