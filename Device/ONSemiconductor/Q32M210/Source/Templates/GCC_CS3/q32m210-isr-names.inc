/* ----------------------------------------------------------------------------
 * q32m210-isr-names.inc
 *  - ISR names for Q32M210
 *
 * Copyright (c) 2011 Semiconductor Components Industries, LLC
 * (d/b/a ON Semiconductor). All rights reserved.
 *
 * This code is the property of ON Semiconductor and may not be redistributed
 * in any form without prior written permission from ON Semiconductor.
 * The terms of use and warranty for this code are covered by contractual
 * agreements between ON Semiconductor and the licensee.
 * ----------------------------------------------------------------------------
 * $Revision: 1.1 $
 * $Date: 2012/05/23 18:49:22 $
 * ------------------------------------------------------------------------- */
EXTERN (NMI_Handler)
EXTERN (HardFault_Handler)
EXTERN (MemManage_Handler)
EXTERN (BusFault_Handler)
EXTERN (UsageFault_Handler)
EXTERN (SVC_Handler)
EXTERN (DebugMon_Handler)
EXTERN (PendSV_Handler)
EXTERN (SysTick_Handler)
EXTERN (WAKEUP_IRQHandler)
EXTERN (WAKEUP_IF5_PIN0_IRQHandler)
EXTERN (RTC_ALARM_IRQHandler)
EXTERN (RTC_CLOCK_IRQHandler)
EXTERN (THRESHOLD_COMPARE_IRQHandler)
EXTERN (NO_EXTCLK_DETECT_IRQHandler)
EXTERN (GPIO_GP0_IRQHandler)
EXTERN (GPIO_GP1_IRQHandler)
EXTERN (WATCHDOG_IRQHandler)
EXTERN (TIMER0_IRQHandler)
EXTERN (TIMER1_IRQHandler)
EXTERN (TIMER2_IRQHandler)
EXTERN (TIMER3_IRQHandler)
EXTERN (UART0_RX_IRQHandler)
EXTERN (UART0_TX_IRQHandler)
EXTERN (UART0_ERROR_IRQHandler)
EXTERN (UART1_RX_IRQHandler)
EXTERN (UART1_TX_IRQHandler)
EXTERN (UART1_ERROR_IRQHandler)
EXTERN (I2C_IRQHandler)
EXTERN (SPI0_IRQHandler)
EXTERN (SPI0_ERROR_IRQHandler)
EXTERN (SPI1_IRQHandler)
EXTERN (SPI1_ERROR_IRQHandler)
EXTERN (PCM_RX_IRQHandler)
EXTERN (PCM_TX_IRQHandler)
EXTERN (PCM_ERROR_IRQHandler)
EXTERN (ADC_IRQHandler)
EXTERN (DMA0_IRQHandler)
EXTERN (DMA1_IRQHandler)
EXTERN (DMA2_IRQHandler)
EXTERN (DMA3_IRQHandler)
EXTERN (USB_WAKEUP_IRQHandler)
EXTERN (USB_SDAV_IRQHandler)
EXTERN (USB_SOF_IRQHandler)
EXTERN (USB_SUTOK_IRQHandler)
EXTERN (USB_SUSPEND_IRQHandler)
EXTERN (USB_RESET_IRQHandler)
EXTERN (USB_EP0IN_IRQHandler)
EXTERN (USB_EP0OUT_IRQHandler)
EXTERN (USB_EP2IN_IRQHandler)
EXTERN (USB_EP3IN_IRQHandler)
EXTERN (USB_EP4OUT_IRQHandler)
EXTERN (USB_EP5OUT_IRQHandler)
EXTERN (ECC_CORRECTED_IRQHandler)
EXTERN (GPIO_GP2_IRQHandler)
EXTERN (GPIO_GP3_IRQHandler)
EXTERN (GPIO_GP4_IRQHandler)
EXTERN (GPIO_GP5_IRQHandler)
EXTERN (GPIO_GP6_IRQHandler)
EXTERN (GPIO_GP7_IRQHandler)
